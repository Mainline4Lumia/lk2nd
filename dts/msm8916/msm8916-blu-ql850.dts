// SPDX-License-Identifier: GPL-2.0-only

/dts-v1/;

#include <skeleton.dtsi>
#include <lk2nd.h>

/ {
	qcom,msm-id = <206 0>;
	qcom,board-id = <11 0>;
	model = "BLU Win HD LTE";
	compatible = "blu,ql850", "qcom,msm8916", "lk2nd,device";

	lk2nd,smd-rpm-hack-opening;
	lk2nd,relocate-fb = <0x83200000>;
	lk2nd,keys =
		<KEY_VOLUMEDOWN 107 (GPIO_PULL_UP | GPIO_ACTIVE_LOW)>,
		<KEY_VOLUMEUP   108 (GPIO_PULL_UP | GPIO_ACTIVE_LOW)>;
};
